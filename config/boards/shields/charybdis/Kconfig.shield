## config/boards/shields/charybdis/Kconfig.shield
```kconfig
# Copyright (c) 2020 The ZMK Contributors
# SPDX-License-Identifier: MIT

config SHIELD_CHARYBDIS_CENTRAL_DONGLE
    def_bool $(shields_list_contains,charybdis_central_dongle)

config SHIELD_CHARYBDIS_CENTRAL_LEFT
    def_bool $(shields_list_contains,charybdis_central_left)

config SHIELD_CHARYBDIS_PERIPHERAL_LEFT
    def_bool $(shields_list_contains,charybdis_peripheral_left)

config SHIELD_CHARYBDIS_PERIPHERAL_RIGHT
    def_bool $(shields_list_contains,charybdis_peripheral_right)
```

## config/west.yml
```yaml
manifest:
  remotes:
    - name: zmkfirmware
      url-base: https://github.com/zmkfirmware
    - name: zero915
      url-base: https://github.com/zero915
    - name: inorichi
      url-base: https://github.com/inorichi
    - name: sayu-hub
      url-base: https://github.com/DoctorWangWang
  projects:
    - name: zmk
      remote: zmkfirmware
      revision: main
      import: app/west.yml
    - name: zmk-pmw3610-driver
      remote: DoctorWangWang
      revision: main
      
  self:
    path: config
```
